## boards/shields/furlukeeb/Kconfig.defconfig
```kconfig
if SHIELD_furlukeeb_LEFT

config ZMK_KEYBOARD_NAME
    default "furlukeeb"

config ZMK_SPLIT_ROLE_CENTRAL
    default y

endif

if SHIELD_furlukeeb_LEFT || SHIELD_furlukeeb_RIGHT

config ZMK_SPLIT
    default y

endif
```

## boards/shields/furlukeeb/Kconfig.shield
```kconfig
config SHIELD_furlukeeb_LEFT
    def_bool $(shields_list_contains,furlukeeb_left)

config SHIELD_furlukeeb_RIGHT
    def_bool $(shields_list_contains,furlukeeb_right)
```

## config/boards/shields/furlukeeb/Kconfig.defconfig
```kconfig
if SHIELD_FURLUKEEB_LEFT

config ZMK_KEYBOARD_NAME
    default "FurluKeeb"

config ZMK_SPLIT_ROLE_CENTRAL
    default y

endif

if SHIELD_FURLUKEEB_LEFT || SHIELD_FURLUKEEB_RIGHT

config ZMK_SPLIT
    default y

endif
```

## config/boards/shields/furlukeeb/Kconfig.shield
```kconfig
config SHIELD_FURLUKEEB_LEFT
    def_bool $(shields_list_contains,FurluKeeb_left)

config SHIELD_FURLUKEEB_RIGHT
    def_bool $(shields_list_contains,FurluKeeb_right)
```

## config/boards/shields/furluvoyager/Kconfig.shield
```kconfig
# Copyright (c) 2020 Pete Johanson
# SPDX-License-Identifier: MIT

config SHIELD_furluvoyager_LEFT
    def_bool $(shields_list_contains,furluvoyager_left)

config SHIELD_furluvoyager_RIGHT
    def_bool $(shields_list_contains,furluvoyager_right)
```
